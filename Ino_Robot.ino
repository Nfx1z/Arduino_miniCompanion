#include <Wire.h>
#include <Adafruit_GFX.h>
#include <Adafruit_SH110X.h>
#include <Adafruit_SHT31.h>
#include <DFRobotDFPlayerMini.h>

// ============================================================================
//  PIN DEFINITIONS
// ============================================================================
#define PIN_I2C_SDA         6
#define PIN_I2C_SCL         7
#define PIN_DFPLAYER_RX     1   // ESP32 RX  <-- DFPlayer TX
#define PIN_DFPLAYER_TX     0   // ESP32 TX  -> (1k ohm resistor) -> DFPlayer RX
#define PIN_PIR             4
#define PIN_TTP_RUB_1       5   // Robot mode: rub sensor 1 | MP3 mode: vol up / next
#define PIN_TTP_RUB_2       10  // Robot mode: rub sensor 2 | MP3 mode: vol down / previous
#define PIN_TTP_MODE        3   // Hold 5s: toggles Robot <-> MP3

// ============================================================================
//  DISPLAY
// ============================================================================
#define SCREEN_WIDTH        128
#define SCREEN_HEIGHT       64
#define OLED_RESET          -1
#define OLED_I2C_ADDR       0x3C

// ============================================================================
//  AUDIO DEFAULTS
// ============================================================================
#define ROBOT_DEFAULT_VOLUME    25   // DFPlayer volume used in Robot mode (0-30)

// ============================================================================
//  MPU6500 (raw register driver)
// ============================================================================
#define MPU_ADDR            0x68
#define REG_PWR_MGMT_1      0x6B
#define REG_ACCEL_CONFIG    0x1C
#define REG_ACCEL_XOUT_H    0x3B
const float MPU_ACCEL_SCALE = 16384.0f;  // LSB/g at +/-2g range
const float MPU_GRAVITY     = 9.80665f;

// ============================================================================
//  TIMING CONSTANTS (milliseconds)
// ============================================================================
#define PLAIN_INACTIVITY_SLEEP_MS 120000UL // No rub activity in PLAIN this long -> sleep
                                            // (only checked once the angry/sad cycle for
                                            // this wake has already been used up)
#define SLEEP_PIR_REARM_DELAY   30000UL  // ignore PIR for this long right after entering sleep
#define RUB_RESET_TIMEOUT       500UL    // 500 ms no touch resets rub accumulator
#define TEMP_READ_INTERVAL          5000UL  // Read SHT30D every 5 s normally
#define TEMP_COOLDOWN_READ_INTERVAL 500UL   // Read every 0.5s during the 10s cooldown window
// State durations
#define DUR_ANGRY               60000UL
#define DUR_SAD                 30000UL
#define DUR_HAPPY               30000UL
#define DUR_DIZZY               30000UL
#define DUR_HOT                 60000UL
#define DUR_FREEZE              60000UL
#define DUR_TEMP_COOLDOWN       10000UL
#define DUR_PLAIN_ANGRY_TRIGGER 60000UL  // Time in plain before angry triggers
#define DUR_WAKE_RUB_LOOP_HOLD_MS 3000UL // How long to stay in the plain loop (after the
                                          // intro finishes) before moving on to happy.
                                          // The intro's own length comes from seqWakeRubIntro
                                          // itself -- see computeDerivedDurations() in setup().

// Rub thresholds
#define RUB_WAKE_THRESHOLD      4000UL   // 4 s rub from sleep
#define RUB_HAPPY_THRESHOLD     2000UL   // 2 s rub from plain

// Sensor thresholds
#define TEMP_HOT_THRESHOLD      33.0f
#define TEMP_COLD_THRESHOLD     20.0f
#define TILT_DELTA_THRESHOLD_DEG 30.0f

// MP3 mode timings/behavior
#define MODE_HOLD_MS             5000UL  // hold Mode button this long to switch
// Wake-from-sleep gesture: tap the Mode button WAKE_TAP_COUNT times in a row.
// Configurable -- set to 2 for double-tap, 3 for triple-tap, etc.
#define WAKE_TAP_COUNT           2
#define WAKE_TAP_MAX_PRESS_MS    400UL   // a press longer than this is a hold, not a tap
#define WAKE_TAP_MAX_GAP_MS      500UL   // max gap between taps to still count as one sequence
// In MP3 mode, tap this many times to toggle looping the current track on/off.
// Uses the same tap-timing constants above (WAKE_TAP_MAX_PRESS_MS / WAKE_TAP_MAX_GAP_MS).
#define MP3_LOOP_TOGGLE_TAP_COUNT 2
#define VOLUME_HOLD_MS           2000UL  // hold vol button this long before it ramps
#define VOLUME_RAMP_INTERVAL_MS  400UL   // step every this many ms while ramping
#define MUSIC_DEFAULT_VOLUME     20      // reset to this on every mode entry
#define MUSIC_VOLUME_MAX         30
#define MUSIC_VOLUME_MIN         0
#define MUSIC_FRAME_DURATION_MS  250UL   // how long each of the 3 MP3-mode frames shows before switching

#define FOLDER_ROBOT  1
#define FOLDER_MP3    2

// ============================================================================
//  ENUMERATIONS
// ============================================================================

// Audio tracks -- match file numbers within /01/ on the SD card (001.mp3 = TRACK_SLEEP, etc.)
enum AudioTrack : uint8_t {
    TRACK_NONE = 0,
    TRACK_SLEEP = 1,
    TRACK_GREET,          // 2
    TRACK_ANGRY,          // 3
    TRACK_SAD,            // 4
    TRACK_HAPPY,          // 5
    TRACK_HAPPY_SLEEP,    // 6
    TRACK_ANGRY_HAPPY,    // 7
    TRACK_SAD_HAPPY,      // 8
    TRACK_DIZZY,          // 9
    TRACK_HOT,            // 10
    TRACK_FREEZE,         // 11
    TRACK_WAKE            // 12 -- plays during the wake-rub sequence, before happy_sleep.mp3
};

// OLED frame indices (must match frameBitmaps[] order)
enum FrameIndex : uint8_t {
    FR_SLEEP_01 = 0,
    FR_SLEEP_02,
    FR_PLAIN_01,
    FR_PLAIN_02,
    FR_ANGRY_01,
    FR_ANGRY_02,
    FR_SAD_01,
    FR_SAD_02,
    FR_HAPPY_00,
    FR_HAPPY_01,
    FR_HAPPY_02,
    FR_DIZZY_01,
    FR_DIZZY_02,
    FR_DIZZY_03,
    FR_DIZZY_04,
    FR_HOT_01,
    FR_HOT_02,
    FR_FREEZE_01,
    FR_FREEZE_02,
    FR_MUSIC_01,
    FR_MUSIC_02,
    FR_MUSIC_03,
    FRAME_COUNT           // = 22
};

// Robot-mode (emotion) states
enum State : uint8_t {
    ST_SLEEP = 0,
    ST_PLAIN,
    ST_ANGRY,
    ST_SAD,
    ST_HAPPY,
    ST_DIZZY,
    ST_HOT,
    ST_FREEZE,
    ST_WAKE_RUB,          // Transitional: sleep -> rub -> happy
    ST_TEMP_COOLDOWN,     // 10 s plain after hot/freeze before re-check
    STATE_COUNT
};

// Top-level operating mode -- only two, toggled by holding Mode (pin 9)
enum OpMode : uint8_t {
    MODE_ROBOT = 0,   // the animatronic/emotion state machine (default)
    MODE_MP3          // simple music player, files 001..N inside /02/ on the SD card
};

// ============================================================================
//  DATA STRUCTURES
// ============================================================================
struct AnimFrame {
    uint8_t  frameIdx;
    uint16_t durationMs;
};

struct AnimSequence {
    const AnimFrame* intro;
    uint8_t          introLen;
    const AnimFrame* loop;
    uint8_t          loopLen;
};

// Tracks a button's hold state for long-press / ramp detection
struct ButtonHoldState {
    bool          pressed        = false;
    unsigned long pressStart     = 0;
    bool          longActionDone = false;  // guards against re-triggering while held
    unsigned long lastStepTime   = 0;
};

// ============================================================================
//  BITMAP PLACEHOLDERS
// ============================================================================
#define BMP_SIZE (SCREEN_WIDTH / 8 * SCREEN_HEIGHT)  // 1024

const uint8_t bmp_sleep_01   [BMP_SIZE] PROGMEM = { 0x00, 0x00, 0x00, 0x00, 0x00, 0x00, 0x00, 0x00, 0x00, 0x00, 0x00, 0x00, 0x00,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 0x00, 0x00 };  // frame 0
const uint8_t bmp_sleep_02   [BMP_SIZE] PROGMEM = { 0x00, 0x00, 0x00, 0x00, 0x00, 0x00, 0x00, 0x00, 0x00, 0x00, 0x00, 0x00, 0x00,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 0x00, 0x00 };  // frame 1
const uint8_t bmp_plain_01   [BMP_SIZE] PROGMEM = { 0x00, 0x00, 0x00, 0x00, 0x00, 0x00, 0x00, 0x00, 0x00, 0x00, 0x00, 0x00, 0x00,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 0x00, 0x00 };  // frame 2
const uint8_t bmp_plain_02   [BMP_SIZE] PROGMEM = { 0x00, 0x00, 0x00, 0x00, 0x00, 0x00, 0x00, 0x00, 0x00, 0x00, 0x00, 0x00, 0x00,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 0x00, 0x00 };  // frame 3
const uint8_t bmp_angry_01   [BMP_SIZE] PROGMEM = { 0x00, 0x00, 0x00, 0x00, 0x00, 0x00, 0x00, 0x00, 0x00, 0x00, 0x00, 0x00, 0x00,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 0x00, 0x00 };  // frame 4
const uint8_t bmp_angry_02   [BMP_SIZE] PROGMEM = { 0x00, 0x00, 0x00, 0x00, 0x00, 0x00, 0x00, 0x00, 0x00, 0x00, 0x00, 0x00, 0x00,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 0x00, 0x00 };  // frame 5
const uint8_t bmp_sad_01     [BMP_SIZE] PROGMEM = { 0x00, 0x00, 0x00, 0x00, 0x00, 0x00, 0x00, 0x00, 0x00, 0x00, 0x00, 0x00, 0x00,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 0x00, 0x00 };  // frame 6
const uint8_t bmp_sad_02     [BMP_SIZE] PROGMEM = { 0x00, 0x00, 0x00, 0x00, 0x00, 0x00, 0x00, 0x00, 0x00, 0x00, 0x00, 0x00, 0x00,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 0x00, 0x00 };  // frame 7
const uint8_t bmp_happy_00   [BMP_SIZE] PROGMEM = { 0x00, 0x00, 0x00, 0x00, 0x00, 0x00, 0x00, 0x00, 0x00, 0x00, 0x00, 0x00, 0x00,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 0x00, 0x00 };  // frame 8
const uint8_t bmp_happy_01   [BMP_SIZE] PROGMEM = { 0x00, 0x00, 0x00, 0x00, 0x00, 0x00, 0x00, 0x00, 0x00, 0x00, 0x00, 0x00, 0x00,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 0x00, 0x00 };  // frame 9
const uint8_t bmp_happy_02   [BMP_SIZE] PROGMEM = { 0x00, 0x00, 0x00, 0x00, 0x00, 0x00, 0x00, 0x00, 0x00, 0x00, 0x00, 0x00, 0x00,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 0x00, 0x00 };  // frame 10
const uint8_t bmp_dizzy_01   [BMP_SIZE] PROGMEM = { 0x00, 0x00, 0x00, 0x00, 0x00, 0x00, 0x00, 0x00, 0x00, 0x00, 0x00, 0x00, 0x00,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 0x00, 0x00 };  // frame 11
const uint8_t bmp_dizzy_02   [BMP_SIZE] PROGMEM = { 0x00, 0x00, 0x00, 0x00, 0x00, 0x00, 0x00, 0x00, 0x00, 0x00, 0x00, 0x00, 0x00,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 0x00, 0x00 };  // frame 12
const uint8_t bmp_dizzy_03   [BMP_SIZE] PROGMEM = { 0x00, 0x00, 0x00, 0x00, 0x00, 0x00, 0x00, 0x00, 0x00, 0x00, 0x00, 0x00, 0x00,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 0x00, 0x00 };  // frame 13
const uint8_t bmp_dizzy_04   [BMP_SIZE] PROGMEM = { 0x00, 0x00, 0x00, 0x00, 0x00, 0x00, 0x00, 0x00, 0x00, 0x00, 0x00, 0x00, 0x00,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 0x00, 0x00 };  // frame 14
const uint8_t bmp_hot_01     [BMP_SIZE] PROGMEM = { 0x00, 0x00, 0x00, 0x00, 0x00, 0x00, 0x00, 0x00, 0x00, 0x00, 0x00, 0x00, 0x00,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 0x00, 0x00 };  // frame 15
const uint8_t bmp_hot_02     [BMP_SIZE] PROGMEM = { 0x00, 0x00, 0x00, 0x00, 0x00, 0x00, 0x00, 0x00, 0x00, 0x00, 0x00, 0x00, 0x00,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 0x00, 0x00 };  // frame 16
const uint8_t bmp_freeze_01  [BMP_SIZE] PROGMEM = { 0x00, 0x00, 0x00, 0x00, 0x00, 0x00, 0x00, 0x00, 0x00, 0x00, 0x00, 0x00, 0x00,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 0x00, 0x00 };  // frame 17
const uint8_t bmp_freeze_02  [BMP_SIZE] PROGMEM = { 0x00, 0x00, 0x00, 0x00, 0x00, 0x00, 0x00, 0x00, 0x00, 0x00, 0x00, 0x00, 0x00,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 0x00, 0x00 };  // frame 18
const uint8_t bmp_music_01   [BMP_SIZE] PROGMEM = { 0x00, 0x00, 0x00, 0x00, 0x00, 0x00, 0x00, 0x00, 0x00, 0x00, 0x00, 0x00, 0x00,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 0x00, 0x00 };  // frame 19
const uint8_t bmp_music_02   [BMP_SIZE] PROGMEM = { 0x00, 0x00, 0x00, 0x00, 0x00, 0x00, 0x00, 0x00, 0x00, 0x00, 0x00, 0x00, 0x00,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 0x00, 0x00 };  // frame 20
const uint8_t bmp_music_03   [BMP_SIZE] PROGMEM = { 0x00, 0x00, 0x00, 0x00, 0x00, 0x00, 0x00, 0x00, 0x00, 0x00, 0x00, 0x00, 0x00,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 0x00, 0x00 };  // frame 21

// Ordered pointer table -- index matches FrameIndex enum
const uint8_t* const frameBitmaps[FRAME_COUNT] = {
    bmp_sleep_01,   bmp_sleep_02,
    bmp_plain_01,   bmp_plain_02,
    bmp_angry_01,   bmp_angry_02,
    bmp_sad_01,     bmp_sad_02,
    bmp_happy_00,   bmp_happy_01,   bmp_happy_02,
    bmp_dizzy_01,   bmp_dizzy_02,   bmp_dizzy_03,   bmp_dizzy_04,
    bmp_hot_01,     bmp_hot_02,
    bmp_freeze_01,  bmp_freeze_02,
    bmp_music_01,   bmp_music_02,   bmp_music_03
};

// ============================================================================
//  ANIMATION SEQUENCES  (unchanged from v1)
// ============================================================================
const AnimFrame seqSleepLoop[] = {
    {FR_SLEEP_01, 500}, {FR_SLEEP_02, 500}
};
const AnimFrame seqPlainLoop[] = {
    {FR_PLAIN_01, 1000}, {FR_PLAIN_02, 250}
};
const AnimFrame seqAngryLoop[] = {
    {FR_ANGRY_01, 1000}, {FR_ANGRY_02, 500}
};
const AnimFrame seqSadLoop[] = {
    {FR_SAD_01, 1000}, {FR_SAD_02, 500}
};
const AnimFrame seqHappyIntro[] = {
    {FR_HAPPY_00, 1000}
};
const AnimFrame seqHappyLoop[] = {
    {FR_HAPPY_01, 500}, {FR_HAPPY_02, 500}
};
const AnimFrame seqDizzyLoop[] = {
    {FR_DIZZY_01, 250}, {FR_DIZZY_02, 250},
    {FR_DIZZY_03, 250}, {FR_DIZZY_04, 250}
};
const AnimFrame seqHotLoop[] = {
    {FR_PLAIN_01, 1000}, {FR_HOT_01, 500},
    {FR_PLAIN_01, 1000}, {FR_HOT_02, 500}
};
const AnimFrame seqFreezeLoopActual[] = {
    {FR_PLAIN_01,   1000},
    {FR_FREEZE_01,  100}, {FR_FREEZE_02, 100},
    {FR_FREEZE_01,  100}, {FR_FREEZE_02, 100},
    {FR_FREEZE_01,  100}, {FR_FREEZE_02, 100},
    {FR_FREEZE_01,  100}, {FR_FREEZE_02, 100},
    {FR_FREEZE_01,  100}, {FR_FREEZE_02, 100},
    {FR_FREEZE_01,  100}, {FR_FREEZE_02, 100},
    {FR_FREEZE_01,  100}, {FR_FREEZE_02, 100},
    {FR_FREEZE_01,  100}
};
const AnimFrame seqWakeRubIntro[] = {
    {FR_PLAIN_02, 1500}
};
// Independent from seqPlainLoop -- edit this (frames AND durations) to change what
// shows during the ~3s after the wake-rub intro, without touching ST_PLAIN's sequence.
const AnimFrame seqWakeRubLoop[] = {
    {FR_PLAIN_01, 500}, {FR_PLAIN_02, 1000}
};
// Same reasoning as seqWakeRubLoop above: this used to point straight at seqPlainLoop,
// so editing it silently did nothing for temp-cooldown specifically. Independent now.
const AnimFrame seqTempCooldownLoop[] = {
    {FR_PLAIN_01, 1000}, {FR_PLAIN_02, 250}
};

const AnimSequence stateAnimations[STATE_COUNT] = {
    /* ST_SLEEP        */ {nullptr,          0, seqSleepLoop,        2 },
    /* ST_PLAIN        */ {nullptr,          0, seqPlainLoop,        2 },
    /* ST_ANGRY        */ {nullptr,          0, seqAngryLoop,        2 },
    /* ST_SAD          */ {nullptr,          0, seqSadLoop,          2 },
    /* ST_HAPPY        */ {seqHappyIntro,    1, seqHappyLoop,        2 },
    /* ST_DIZZY        */ {nullptr,          0, seqDizzyLoop,        4 },
    /* ST_HOT          */ {nullptr,          0, seqHotLoop,          4 },
    /* ST_FREEZE       */ {nullptr,          0, seqFreezeLoopActual, 16},
    /* ST_WAKE_RUB     */ {seqWakeRubIntro,  1, seqWakeRubLoop,      2 },
    /* ST_TEMP_COOLDOWN*/ {nullptr,          0, seqTempCooldownLoop, 2 }
};

// ============================================================================
//  HARDWARE OBJECTS
// ============================================================================
Adafruit_SH1106G       display(SCREEN_WIDTH, SCREEN_HEIGHT, &Wire, OLED_RESET);
Adafruit_SHT31         sht30 = Adafruit_SHT31();
HardwareSerial         dfSerial(1);     // UART1 for DFPlayer
DFRobotDFPlayerMini    dfPlayer;

// ============================================================================
//  TOP-LEVEL MODE
// ============================================================================
OpMode currentMode = MODE_ROBOT;

// ============================================================================
//  STATE MACHINE VARIABLES (Robot mode)
// ============================================================================
State         currentState     = ST_SLEEP;
State         previousState    = ST_PLAIN;
unsigned long stateStartTime   = 0;
uint8_t       stateAudioTrack  = TRACK_NONE;

// Computed once in setup() from seqWakeRubIntro's actual frame durations, so editing
// that array is the ONLY place you need to change this -- no more silently-desynced
// magic number here.
unsigned long DUR_WAKE_RUB_TOTAL = 0;

// ============================================================================
//  ANIMATION ENGINE (Robot mode)
// ============================================================================
enum AnimPhase : uint8_t { PHASE_INTRO, PHASE_LOOP };
AnimPhase     animPhase        = PHASE_LOOP;
uint8_t       animFrameIdx     = 0;
unsigned long lastFrameChange  = 0;

// ============================================================================
//  AUDIO ENGINE (shared between Robot + MP3 modes)
// ============================================================================
int           currentTrack     = TRACK_NONE;
bool          audioLooping     = false;

// ============================================================================
//  CYCLE TRACKING  (reset every time the device enters SLEEP)
// ============================================================================
bool cycleAngryUsed          = false;
bool cycleSadUsed            = false;
bool happyPreventsAngrySad   = false;

// ============================================================================
//  RUB TRACKING  (Robot mode only -- genuine alternating touch required)
// ============================================================================
enum RubPad : uint8_t { RUB_PAD_NONE = 0, RUB_PAD_1, RUB_PAD_2 };

bool          isRubbing        = false;
unsigned long rubStartTime     = 0;
unsigned long rubAccumulated   = 0;
unsigned long lastRubTime      = 0;
RubPad        lastActivePad    = RUB_PAD_NONE;

// ============================================================================
//  PIR TRACKING
// ============================================================================
bool          pirDetected      = false;

// ============================================================================
//  TEMPERATURE
// ============================================================================
float         currentTemp      = 25.0f;
unsigned long lastTempRead     = 0;
bool          tempExceedsHot   = false;
bool          tempExceedsCold  = false;
float         tempCooldownSum   = 0.0f;
uint8_t       tempCooldownCount = 0;

// ============================================================================
//  TILT / MPU6500
// ============================================================================
bool  tiltDetected    = false;
float lastPitchDeg    = 0.0f;
float lastRollDeg     = 0.0f;
bool  tiltBaselineSet = false;

// ============================================================================
//  MP3 MODE STATE
// ============================================================================
ButtonHoldState modeBtn;
uint8_t         modeTapCount    = 0;   // consecutive quick taps counted so far
unsigned long   modeLastTapTime = 0;
bool            mp3WasPlaying   = false;  // used to restore play/pause state after a mode switch
ButtonHoldState volUpBtn;    // PIN_TTP_RUB_1 while in MP3 mode
ButtonHoldState volDownBtn;  // PIN_TTP_RUB_2 while in MP3 mode

uint8_t  musicVolume            = MUSIC_DEFAULT_VOLUME;
uint16_t currentMp3Track      = 1;      // 1-based file number within /02/
uint16_t mp3TrackCount        = 1;      // queried fresh from the card every MP3-mode entry
bool     mp3LoopCurrent       = false;  // toggled by double-tapping the mode button in MP3 mode
bool     mp3Paused            = false;  // toggled by single-tapping the mode button in MP3 mode

uint8_t       musicAnimFrame        = 0;  // 0/1/2 -> FR_MUSIC_01/02/03
unsigned long lastMusicFrameChange  = 0;
unsigned long mp3OverlayUntil       = 0;  // millis() timestamp; while now < this, show the info overlay
unsigned long lastTrackAdvanceTime  = 0;  // millis() timestamp of the last next/prev track change
#define MP3_OVERLAY_DURATION_MS  2000UL   // how long Track/Vol text stays up after a change

// ============================================================================
//  FORWARD DECLARATIONS
// ============================================================================
void enterState(State newState);
void displayFrame(uint8_t frameIdx);
void updateAnimation(unsigned long now);
void playAudio(uint8_t track);
void stopAudio();
void updateAudio();
void readSensors(unsigned long now);
void updateRubTracking(unsigned long now);
void mpuInit();
bool mpuReadAccel(int16_t &ax, int16_t &ay, int16_t &az);
float wrapDelta(float delta);
void enterMp3Mode();
void enterRobotMode();
void playCurrentMp3Track();
void nextMp3Track(unsigned long now);
void prevMp3Track(unsigned long now);
void toggleMp3PlayPause();
void displayMusicScreen(bool showOverlay);
void updateMusicAnimation(unsigned long now);
void handleModeButton(unsigned long now);
void handleMusicButtons(unsigned long now);

// ============================================================================
//  MPU6500 RAW REGISTER DRIVER
// ============================================================================
void mpuWriteReg(uint8_t reg, uint8_t val) {
    Wire.beginTransmission(MPU_ADDR);
    Wire.write(reg);
    Wire.write(val);
    Wire.endTransmission();
}

void mpuInit() {
    mpuWriteReg(REG_PWR_MGMT_1, 0x00);   // wake -- defaults to sleep on power-up
    delay(50);
    mpuWriteReg(REG_ACCEL_CONFIG, 0x00); // +/-2g range, matches MPU_ACCEL_SCALE
    delay(10);
}

bool mpuReadAccel(int16_t &ax, int16_t &ay, int16_t &az) {
    Wire.beginTransmission(MPU_ADDR);
    Wire.write(REG_ACCEL_XOUT_H);
    if (Wire.endTransmission(false) != 0) return false;
    if (Wire.requestFrom(MPU_ADDR, (uint8_t)6) != 6) return false;

    ax = (Wire.read() << 8) | Wire.read();
    ay = (Wire.read() << 8) | Wire.read();
    az = (Wire.read() << 8) | Wire.read();
    return true;
}

float wrapDelta(float delta) {
    while (delta > 180.0f)  delta -= 360.0f;
    while (delta < -180.0f) delta += 360.0f;
    return delta;
}
// ============================================================================
//  SETUP
// ============================================================================

// Sums the frame durations of an AnimFrame sequence. Used so state-transition
// timing can be derived from the animation data itself instead of a hand-kept
// duplicate constant that silently goes stale when you edit the sequence.
unsigned long sumSeqDuration(const AnimFrame* seq, uint8_t len) {
    unsigned long total = 0;
    for (uint8_t i = 0; i < len; i++) total += seq[i].durationMs;
    return total;
}

void computeDerivedDurations() {
    DUR_WAKE_RUB_TOTAL = sumSeqDuration(seqWakeRubIntro, 1) + DUR_WAKE_RUB_LOOP_HOLD_MS;
}

void setup() {
    Serial.begin(115200);
    delay(300);
    Serial.println(F("\n--- Companion Boot (v2) ---"));

    computeDerivedDurations();

    // -- GPIO --
    pinMode(PIN_PIR,       INPUT);
    pinMode(PIN_TTP_RUB_1, INPUT);
    pinMode(PIN_TTP_RUB_2, INPUT);
    pinMode(PIN_TTP_MODE,  INPUT);

    // -- I2C --
    Wire.begin(PIN_I2C_SDA, PIN_I2C_SCL);
    Wire.setClock(400000);

    // -- OLED --
    if (!display.begin(OLED_I2C_ADDR, true)) {
        Serial.println(F("[ERR] SH1106 alloc failed"));
        while (true) { yield(); }
    }
    display.clearDisplay();
    display.display();
    Serial.println(F("[OK ] OLED SH1106"));

    Wire.begin(PIN_I2C_SDA, PIN_I2C_SCL);
    Wire.setClock(400000);

    // -- DFPlayer Mini --
    dfSerial.begin(9600, SERIAL_8N1, PIN_DFPLAYER_RX, PIN_DFPLAYER_TX);
    Serial.println(F("Waiting 3s for DFPlayer SD initialization..."));
    delay(3000);  // this module needs the full 3s -- 500ms was too short
    if (!dfPlayer.begin(dfSerial, false, true)) {  // isACK=false, doReset=true
        Serial.println(F("[ERR] DFPlayer not found"));
    } else {
        dfPlayer.setTimeOut(500);
        dfPlayer.volume(ROBOT_DEFAULT_VOLUME);
        dfPlayer.EQ(0);
        dfPlayer.outputDevice(DFPLAYER_DEVICE_SD);
        Serial.println(F("[OK ] DFPlayer"));
    }

    // -- MPU6500 (raw driver -- see header comment) --
    mpuInit();
    Serial.println(F("[OK ] MPU6500 woken + configured"));

    // -- SHT30D --
    if (!sht30.begin(0x44)) {
        Serial.println(F("[ERR] SHT30D not found"));
    } else {
        Serial.println(F("[OK ] SHT30D"));
    }

    Wire.begin(PIN_I2C_SDA, PIN_I2C_SCL);
    Wire.setClock(400000);

    // -- Enter initial mode/state --
    currentMode = MODE_ROBOT;
    enterState(ST_SLEEP);
    Serial.println(F("--- Ready ---"));
}

// ============================================================================
//  ENTER STATE (Robot mode -- unchanged from v1)
// ============================================================================
void enterState(State newState) {
    previousState   = currentState;
    currentState    = newState;
    stateStartTime  = millis();

    const AnimSequence& anim = stateAnimations[newState];
    if (anim.introLen > 0) {
        animPhase    = PHASE_INTRO;
        animFrameIdx = 0;
        displayFrame(anim.intro[0].frameIdx);
    } else if (anim.loopLen > 0) {
        animPhase    = PHASE_LOOP;
        animFrameIdx = 0;
        displayFrame(anim.loop[0].frameIdx);
    }
    lastFrameChange = millis();

    switch (newState) {
        case ST_SLEEP:
            stateAudioTrack = TRACK_SLEEP;
            cycleAngryUsed        = false;
            cycleSadUsed          = false;
            happyPreventsAngrySad = false;
            break;
        case ST_PLAIN:
            stateAudioTrack = TRACK_NONE;
            break;
        case ST_ANGRY:
            stateAudioTrack = TRACK_ANGRY;
            cycleAngryUsed  = true;
            break;
        case ST_SAD:
            stateAudioTrack = TRACK_SAD;
            cycleSadUsed    = true;
            break;
        case ST_HAPPY:
            if (stateAudioTrack == TRACK_NONE) stateAudioTrack = TRACK_HAPPY;
            happyPreventsAngrySad = true;
            break;
        case ST_DIZZY:
            stateAudioTrack = TRACK_DIZZY;
            break;
        case ST_HOT:
            stateAudioTrack = TRACK_HOT;
            break;
        case ST_FREEZE:
            stateAudioTrack = TRACK_FREEZE;
            break;
        case ST_WAKE_RUB:
            stateAudioTrack = TRACK_WAKE;   // plays through the plain_02+plain sequence, until happy_sleep.mp3 takes over
            break;
        case ST_TEMP_COOLDOWN:
            stateAudioTrack = TRACK_NONE;
            break;
        default:
            stateAudioTrack = TRACK_NONE;
            break;
    }

    playAudio(stateAudioTrack);

    Serial.print(F("STATE -> "));
    Serial.println(newState);
}

// ============================================================================
//  DISPLAY A SINGLE FRAME
// ============================================================================
void displayFrame(uint8_t frameIdx) {
    if (frameIdx >= FRAME_COUNT) return;
    display.clearDisplay();
    display.drawBitmap(0, 0, frameBitmaps[frameIdx],
                       SCREEN_WIDTH, SCREEN_HEIGHT, SH110X_WHITE);
    display.display();
}

// ============================================================================
//  ANIMATION ENGINE (Robot mode -- unchanged)
// ============================================================================
void updateAnimation(unsigned long now) {
    const AnimSequence& anim = stateAnimations[currentState];

    const AnimFrame* seq;
    uint8_t          seqLen;

    if (animPhase == PHASE_INTRO && anim.introLen > 0) {
        seq    = anim.intro;
        seqLen = anim.introLen;
    } else {
        seq    = anim.loop;
        seqLen = anim.loopLen;
        if (animPhase == PHASE_INTRO) animPhase = PHASE_LOOP;
    }

    if (seqLen == 0) return;

    if (now - lastFrameChange >= seq[animFrameIdx].durationMs) {
        animFrameIdx++;

        if (animFrameIdx >= seqLen) {
            if (animPhase == PHASE_INTRO && anim.introLen > 0) {
                animPhase    = PHASE_LOOP;
                animFrameIdx = 0;
                seq          = anim.loop;
                seqLen       = anim.loopLen;
            } else {
                animFrameIdx = 0;
            }
        }

        if (seqLen > 0) {
            displayFrame(seq[animFrameIdx].frameIdx);
        }
        lastFrameChange = now;
    }
}

// ============================================================================
//  SERIAL DEBUG: type a number + Enter in the Serial Monitor (115200 baud) to
//  play that RAW file position directly, bypassing every mode/state/array in
//  this sketch entirely. Use this to build a ground-truth map of "position N
//  actually contains X" by ear, instead of guessing at filename vs. FAT order.
// ============================================================================
void handleSerialDebug() {
    if (Serial.available()) {
        int n = Serial.parseInt();
        while (Serial.available()) Serial.read();   // flush the rest of the line
        if (n > 0) {
            Serial.print(F("[DEBUG] Playing raw file position "));
            Serial.println(n);
            dfPlayer.play(n);
        }
    }
}

// ============================================================================
//  AUDIO ENGINE
// ============================================================================
void playAudio(uint8_t track) {
    if (track == TRACK_NONE) {
        stopAudio();
        return;
    }
    currentTrack = track;
    audioLooping = false;   // play once, do not re-trigger on DFPlayerPlayFinished
    dfPlayer.playFolder(FOLDER_ROBOT, track);
}

void stopAudio() {
    dfPlayer.stop();
    currentTrack = TRACK_NONE;
    audioLooping = false;
}

void updateAudio() {
    if (dfPlayer.available()) {
        uint8_t type  = dfPlayer.readType();
        int     value = dfPlayer.read();

        if (type == DFPlayerPlayFinished) {
            if (currentMode == MODE_MP3) {
                if (mp3LoopCurrent) {
                    dfPlayer.playFolder(FOLDER_MP3, currentTrack);
                } else {
                    nextMp3Track(millis());   // not looping -- auto-advance when a track ends
                }
            } else if (audioLooping && currentTrack != TRACK_NONE) {
                dfPlayer.playFolder(FOLDER_ROBOT, currentTrack);
            }
        } else if (type == DFPlayerError) {
            Serial.print(F("DFPlayer Error "));
            Serial.print(value);
            Serial.print(F(" ("));
            switch (value) {
                case 1: Serial.print(F("Busy/module not ready"));      break;
                case 2: Serial.print(F("Sleeping"));                   break;
                case 3: Serial.print(F("Serial wrong stack"));         break;
                case 4: Serial.print(F("Checksum mismatch"));          break;
                case 5: Serial.print(F("File index out of range"));   break;
                case 6: Serial.print(F("File mismatch/not found"));    break;
                case 7: Serial.print(F("Advertise (in-play prompt)")); break;
                default: Serial.print(F("Unknown"));                  break;
            }
            Serial.print(F(") while requesting /"));
            Serial.print(currentMode == MODE_MP3 ? FOLDER_MP3 : FOLDER_ROBOT);
            Serial.print(F("/"));
            Serial.println(currentTrack);

            // A missing/broken file never sends DFPlayerPlayFinished, so without this
            // it would just go silent and sit there forever -- looping or not -- until
            // someone notices and taps next manually. Skip past it automatically instead.
            if (currentMode == MODE_MP3 && (value == 5 || value == 6)) {
                nextMp3Track(millis());
            }
        }
    }
}

// ============================================================================
//  SENSOR READING  (Robot mode -- call every loop iteration while active)
// ============================================================================
void readSensors(unsigned long now) {
    // -- PIR --
    pirDetected = (digitalRead(PIN_PIR) == HIGH);

    unsigned long tempInterval = (currentState == ST_TEMP_COOLDOWN)
                                    ? TEMP_COOLDOWN_READ_INTERVAL
                                    : TEMP_READ_INTERVAL;

    if (now - lastTempRead >= tempInterval) {
        lastTempRead = now;
        float t = sht30.readTemperature();
        if (!isnan(t)) {
            currentTemp = t;

            if (currentState == ST_TEMP_COOLDOWN) {
                tempCooldownSum += t;
                tempCooldownCount++;
            }

            tempExceedsHot  = (currentTemp > TEMP_HOT_THRESHOLD);
            tempExceedsCold = (currentTemp < TEMP_COLD_THRESHOLD);
        }
    }

    // -- MPU6500 tilt (raw driver) --
    int16_t rawX, rawY, rawZ;
    if (mpuReadAccel(rawX, rawY, rawZ)) {
        float ax = (rawX / MPU_ACCEL_SCALE) * MPU_GRAVITY;
        float ay = (rawZ / MPU_ACCEL_SCALE) * MPU_GRAVITY;   // old Z -> front/back tilt (physical mount rotated 90deg)
        float az = (rawY / MPU_ACCEL_SCALE) * MPU_GRAVITY;   // old Y -> "up" (gravity axis)

        float pitchDeg = atan2f(ay, az) * 180.0f / PI;
        float rollDeg  = atan2f(ax, az) * 180.0f / PI;

        if (!tiltBaselineSet) {
            lastPitchDeg    = pitchDeg;
            lastRollDeg     = rollDeg;
            tiltBaselineSet = true;
        }

        float pitchDelta = fabsf(wrapDelta(pitchDeg - lastPitchDeg));
        float rollDelta  = fabsf(wrapDelta(rollDeg  - lastRollDeg));

        tiltDetected = (pitchDelta > TILT_DELTA_THRESHOLD_DEG ||
                        rollDelta  > TILT_DELTA_THRESHOLD_DEG);

        lastPitchDeg = pitchDeg;
        lastRollDeg  = rollDeg;
    }
}

// ============================================================================
//  RUB TRACKING  (Robot mode only)
// ============================================================================
void updateRubTracking(unsigned long now) {
    bool pad1 = (digitalRead(PIN_TTP_RUB_1) == HIGH);
    bool pad2 = (digitalRead(PIN_TTP_RUB_2) == HIGH);
    bool anyPad = (pad1 || pad2);   // simultaneous touch is fine now -- a real
                                    // stroke often clips both pads for an instant,
                                    // and that should never wipe out progress.

    if (anyPad) {
        isRubbing   = true;
        lastRubTime = now;

        if (rubStartTime == 0) {
            // First touch of a new rub gesture
            rubStartTime   = now;
            rubAccumulated = 0;
        } else {
            rubAccumulated = now - rubStartTime;
        }
        lastActivePad = pad1 ? RUB_PAD_1 : RUB_PAD_2;  // kept for diagnostics only
    } else {
        isRubbing = false;
        if (now - lastRubTime > RUB_RESET_TIMEOUT) {
            // No touch on either pad for a while -- genuine gap, reset the gesture
            rubAccumulated = 0;
            rubStartTime   = 0;
            lastActivePad  = RUB_PAD_NONE;
        }
        // If still within RUB_RESET_TIMEOUT, treat this as a brief gap mid-gesture:
        // rubStartTime is left alone so rubAccumulated keeps growing on next touch.
    }
}

// ============================================================================
//  MP3 MODE
// ============================================================================

void displayMusicScreen(bool showOverlay) {
    display.clearDisplay();

    if (showOverlay) {
        // Info overlay takes priority -- the music frame is cleared/paused
        // entirely while this is up, not drawn underneath the text.
        display.setTextColor(SH110X_WHITE);
        display.setTextSize(2);

        display.setCursor(34, 2);

        // currentMp3Track is already the actual file number within /02/,
        // so it directly reflects what filename to expect on the card.
        // display.print(F("Track "));
        // if (currentMp3Track < 100) display.print('0');
        if (currentMp3Track < 10)  display.print('0');
        display.print(currentMp3Track);
        display.print('/');
        display.println(mp3TrackCount);

        // Volume bar: outlined track + a filled portion proportional to music volume
        display.setTextSize(1);
        display.setCursor(2, 26);
        display.print("Vol: ");
        display.print(musicVolume);
        display.print(F("    Loop "));
        display.print(mp3LoopCurrent ? F("ON") : F("OFF"));
        // Volume bar
        const int barX = 2, barY = 40, barW = SCREEN_WIDTH - 4, barH = 12;
        display.drawRect(barX, barY, barW, barH, SH110X_WHITE);
        int fillW = (int)((long)(barW - 2) * musicVolume / MUSIC_VOLUME_MAX);
        if (fillW > 0) {
            display.fillRect(barX + 1, barY + 1, fillW, barH - 2, SH110X_WHITE);
        }
    } else {
        // Normal state: just cycle the music frame, no text on top of it.
        static const uint8_t musicFrames[3] = { FR_MUSIC_01, FR_MUSIC_02, FR_MUSIC_03 };
        uint8_t frameIdx = musicFrames[musicAnimFrame];
        display.drawBitmap(0, 0, frameBitmaps[frameIdx],
                           SCREEN_WIDTH, SCREEN_HEIGHT, SH110X_WHITE);
    }

    display.display();
}

// Call this whenever a volume or track change happens: shows the info
// overlay immediately and arms the 2s window before it reverts to the
// plain frame-cycling animation.
void showMp3Overlay(unsigned long now) {
    mp3OverlayUntil      = now + MP3_OVERLAY_DURATION_MS;
    lastMusicFrameChange = now;   // resume frame cycling fresh once overlay ends
    displayMusicScreen(true);
}

// Call every loop iteration while in MP3 mode -- cycles FR_MUSIC_01/02/03
// every MUSIC_FRAME_DURATION_MS, mirroring the same loop pattern the Robot
// mode's other animations use.
void updateMusicAnimation(unsigned long now) {
    if (now < mp3OverlayUntil) {
        return;   // info overlay is still showing -- leave it up, don't touch frames
    }
    if (mp3Paused) {
        return;   // paused -- leave the current frame up, don't cycle
    }
    if (now - lastMusicFrameChange >= MUSIC_FRAME_DURATION_MS) {
        lastMusicFrameChange = now;
        musicAnimFrame = (musicAnimFrame + 1) % 3;
        displayMusicScreen(false);
    }
}

void playCurrentMp3Track() {
    dfPlayer.playFolder(FOLDER_MP3, currentMp3Track);
    currentTrack = currentMp3Track;
    mp3Paused = false;
}

void nextMp3Track(unsigned long now) {
  // Debounce: If we advanced a track less than 500ms ago, ignore this duplicate trigger
  if (now - lastTrackAdvanceTime < 500) return; 
  lastTrackAdvanceTime = now;

  currentMp3Track++;
  if (currentMp3Track > mp3TrackCount) {
    currentMp3Track = 1;
  }
  playCurrentMp3Track();
  showMp3Overlay(now);
}

void prevMp3Track(unsigned long now) {
  // Debounce: If we advanced a track less than 500ms ago, ignore this duplicate trigger
  if (now - lastTrackAdvanceTime < 500) return; 
  lastTrackAdvanceTime = now;

  if (currentMp3Track <= 1) {
    currentMp3Track = mp3TrackCount;
  } else {
    currentMp3Track--;
  }
  playCurrentMp3Track();
  showMp3Overlay(now);
}

void toggleMp3PlayPause() {
    if (mp3Paused) {
        dfPlayer.start();
        mp3Paused = false;
        Serial.println(F("[MP3] Resume"));
    } else {
        dfPlayer.pause();
        mp3Paused = true;
        Serial.println(F("[MP3] Pause"));
    }
    showMp3Overlay(millis());
}
// ============================================================================
//  MODE TRANSITIONS
// ============================================================================
void enterMp3Mode() {
    currentMode = MODE_MP3;

    stopAudio();

    rubAccumulated          = 0;
    rubStartTime            = 0;
    lastRubTime             = 0;
    isRubbing               = false;
    lastActivePad           = RUB_PAD_NONE;
    tempCooldownSum         = 0.0f;
    tempCooldownCount       = 0;
    tiltDetected            = false;
    cycleAngryUsed          = false;
    cycleSadUsed            = false;
    happyPreventsAngrySad   = false;

    // Initialize MP3 mode defaults
    musicVolume = MUSIC_DEFAULT_VOLUME;
    dfPlayer.volume(musicVolume);
    currentMp3Track = 1;
    mp3LoopCurrent  = false;

    // Query how many tracks are in /02/ right now -- this is what lets you just
    // drop in a new sequentially-numbered file with no code changes at all.
    uint16_t count = dfPlayer.readFileCountsInFolder(FOLDER_MP3);
    mp3TrackCount = (count > 0) ? count : 1;  // fallback if query fails or folder is empty

    volUpBtn             = ButtonHoldState();
    volDownBtn           = ButtonHoldState();
    musicAnimFrame       = 0;
    lastMusicFrameChange = millis();

    playCurrentMp3Track();
    showMp3Overlay(millis());

    Serial.println(F("MODE -> MP3"));
}
void enterRobotMode() {
    currentMode = MODE_ROBOT;

    cycleAngryUsed          = false;
    cycleSadUsed            = false;
    happyPreventsAngrySad   = false;

    rubAccumulated          = 0;
    rubStartTime            = 0;
    lastRubTime             = 0;
    isRubbing               = false;
    lastActivePad           = RUB_PAD_NONE;
    tiltDetected            = false;
    tempCooldownSum         = 0.0f;
    tempCooldownCount       = 0;

    enterState(ST_PLAIN);

    volUpBtn   = ButtonHoldState();
    volDownBtn = ButtonHoldState();

    Serial.println(F("MODE -> ROBOT (PLAIN)"));
}

// Mode button (pin 9): tap WAKE_TAP_COUNT times quickly while ASLEEP to wake to plain.
// In MP3 mode, double-tap toggles looping the current track vs. auto-advancing to
// the next one when it ends (see MP3_LOOP_TOGGLE_TAP_COUNT).
// Hold 5s (from either mode) to toggle Robot <-> MP3.
void handleModeButton(unsigned long now) {
    bool pressed = (digitalRead(PIN_TTP_MODE) == HIGH);

    if (pressed) {
        if (!modeBtn.pressed) {
            modeBtn.pressed        = true;
            modeBtn.pressStart     = now;
            modeBtn.longActionDone = false;
        } else if (!modeBtn.longActionDone &&
                   (now - modeBtn.pressStart >= MODE_HOLD_MS)) {
            modeBtn.longActionDone = true;  // guard: only fire once per hold
            modeTapCount = 0;               // a long hold cancels any tap sequence in progress
            if (currentMode == MODE_ROBOT) {
                enterMp3Mode();
            } else {
                enterRobotMode();
            }
        }
    } else {
        if (modeBtn.pressed && !modeBtn.longActionDone) {
            // Released after a short press -- was it quick enough to count as a tap?
            unsigned long pressDuration = now - modeBtn.pressStart;
            if (pressDuration <= WAKE_TAP_MAX_PRESS_MS) {
                if (modeTapCount > 0 && (now - modeLastTapTime) > WAKE_TAP_MAX_GAP_MS) {
                    modeTapCount = 0;   // previous tap too long ago -- start a fresh sequence
                }
                if (modeTapCount == 0 && currentMode == MODE_MP3) {
                    mp3WasPlaying = !mp3Paused;   // remember the play/pause state so we can restore it after the tap sequence
                }
                modeTapCount++;
                modeLastTapTime = now;

                if (currentMode == MODE_ROBOT && currentState == ST_SLEEP &&
                    modeTapCount >= WAKE_TAP_COUNT)
                {
                    modeTapCount = 0;
                    enterState(ST_PLAIN);
                    dfPlayer.playFolder(FOLDER_ROBOT, TRACK_GREET);
                    currentTrack = TRACK_GREET;
                    audioLooping = false;
                }
                else if (currentMode == MODE_MP3 && modeTapCount >= MP3_LOOP_TOGGLE_TAP_COUNT)
                {
                    modeTapCount = 0;
                    mp3LoopCurrent = !mp3LoopCurrent;
                    if (mp3WasPlaying == mp3Paused) {
                        toggleMp3PlayPause();   // restore play/pause state after the tap sequence
                    }else{
                        showMp3Overlay(now);   // just show the overlay if we didn't change play/pause state
                    }
                }
                else if (currentMode == MODE_MP3 && modeTapCount == 1) {
                    // Fires immediately on this release, no waiting to see if a 2nd tap follows.
                    toggleMp3PlayPause();
                }
            } else {
                modeTapCount = 0;   // held too long to be a tap -- break the sequence
            }
        }
        modeBtn.pressed        = false;
        modeBtn.longActionDone = false;
    }

    // Drop a stalled tap sequence even if the button hasn't been pressed again
    if (modeTapCount > 0 && !modeBtn.pressed && (now - modeLastTapTime) > WAKE_TAP_MAX_GAP_MS) {
        modeTapCount = 0;
    }
}

void handleMusicButtons(unsigned long now) {
    // -- Volume Up / Next --
    bool p1 = (digitalRead(PIN_TTP_RUB_1) == HIGH);
    if (p1) {
        if (!volUpBtn.pressed) {
            volUpBtn.pressed        = true;
            volUpBtn.pressStart     = now;
            volUpBtn.longActionDone = false;
            volUpBtn.lastStepTime   = now;
        } else if (now - volUpBtn.pressStart >= VOLUME_HOLD_MS) {
            if (!volUpBtn.longActionDone ||
                now - volUpBtn.lastStepTime >= VOLUME_RAMP_INTERVAL_MS) {
                volUpBtn.longActionDone = true;
                volUpBtn.lastStepTime   = now;
                if (musicVolume < MUSIC_VOLUME_MAX) {
                    musicVolume++;
                    dfPlayer.volume(musicVolume);
                    showMp3Overlay(now);
                }
            }
        }
    } else {
        if (volUpBtn.pressed && !volUpBtn.longActionDone) {
            nextMp3Track(now);   // short press -> next track
        }
        volUpBtn.pressed        = false;
        volUpBtn.longActionDone = false;
    }

    // -- Volume Down / Previous --
    bool p2 = (digitalRead(PIN_TTP_RUB_2) == HIGH);
    if (p2) {
        if (!volDownBtn.pressed) {
            volDownBtn.pressed        = true;
            volDownBtn.pressStart     = now;
            volDownBtn.longActionDone = false;
            volDownBtn.lastStepTime   = now;
        } else if (now - volDownBtn.pressStart >= VOLUME_HOLD_MS) {
            if (!volDownBtn.longActionDone ||
                now - volDownBtn.lastStepTime >= VOLUME_RAMP_INTERVAL_MS) {
                volDownBtn.longActionDone = true;
                volDownBtn.lastStepTime   = now;
                if (musicVolume > MUSIC_VOLUME_MIN) {
                    musicVolume--;
                    dfPlayer.volume(musicVolume);
                    showMp3Overlay(now);
                }
            }
        }
    } else {
        if (volDownBtn.pressed && !volDownBtn.longActionDone) {
            prevMp3Track(now);   // short press -> previous track
        }
        volDownBtn.pressed        = false;
        volDownBtn.longActionDone = false;
    }
}

// ============================================================================
//  MAIN LOOP
// ============================================================================
void loop() {
    unsigned long now = millis();

    handleSerialDebug();
    updateAudio();
    handleModeButton(now);

    if (currentMode == MODE_MP3) {
        handleMusicButtons(now);
        updateMusicAnimation(millis());  // fresh timestamp -- see the comment on the
                                          // updateAnimation() call further down for why
        return;
    }

    readSensors(now);
    updateRubTracking(now);

    // ---- Global overrides (highest priority) ----

    // Dizzy override -- from ANY Robot-mode state except already dizzy
    if (currentState != ST_DIZZY && tiltDetected) {
        enterState(ST_DIZZY);
        return;
    }

    // Temperature extreme -- from SLEEP or PLAIN only
    if (currentState == ST_SLEEP || currentState == ST_PLAIN) {
        if (tempExceedsHot) {
            enterState(ST_HOT);
            return;
        }
        if (tempExceedsCold) {
            enterState(ST_FREEZE);
            return;
        }
    }

    // ---- State-specific logic ----
    unsigned long stateElapsed = now - stateStartTime;   // always reflects the CURRENT state,
                                                          // since nothing above falls through
                                                          // to here after changing currentState
    switch (currentState) {

        case ST_SLEEP:
            if (rubAccumulated >= RUB_WAKE_THRESHOLD) {
                enterState(ST_WAKE_RUB);
            } else if (stateElapsed >= SLEEP_PIR_REARM_DELAY && pirDetected) {
                // PIR is ignored for the first SLEEP_PIR_REARM_DELAY ms of sleep.
                // Only after that window do we even look at it again.
                enterState(ST_PLAIN);
                dfPlayer.playFolder(FOLDER_ROBOT, TRACK_GREET);
                currentTrack = TRACK_GREET;
                audioLooping = false;
            }
            break;

        case ST_PLAIN:
            if (rubAccumulated >= RUB_HAPPY_THRESHOLD &&
                stateElapsed < DUR_PLAIN_ANGRY_TRIGGER)
            {
                stateAudioTrack = TRACK_HAPPY;
                enterState(ST_HAPPY);
            }
            else if (stateElapsed >= DUR_PLAIN_ANGRY_TRIGGER) {
                if (!happyPreventsAngrySad && !cycleAngryUsed) {
                    enterState(ST_ANGRY);
                } else if (stateElapsed >= PLAIN_INACTIVITY_SLEEP_MS) {
                    // Already been through the angry/sad cycle (or happy) this
                    // wake -- no more of those, so fall asleep after this long
                    // with no rub, regardless of PIR.
                    enterState(ST_SLEEP);
                }
            }
            break;

        case ST_ANGRY:
            if (rubAccumulated >= RUB_HAPPY_THRESHOLD) {
                stateAudioTrack = TRACK_ANGRY_HAPPY;
                enterState(ST_HAPPY);
            } else if (stateElapsed >= DUR_ANGRY) {
                if (!happyPreventsAngrySad && !cycleSadUsed) {
                    enterState(ST_SAD);
                } else {
                    enterState(ST_PLAIN);
                }
            }
            break;

        case ST_SAD:
            if (rubAccumulated >= RUB_HAPPY_THRESHOLD) {
                stateAudioTrack = TRACK_SAD_HAPPY;
                enterState(ST_HAPPY);
            } else if (stateElapsed >= DUR_SAD) {
                enterState(ST_PLAIN);
            }
            break;

        case ST_HAPPY:
            if (stateElapsed >= DUR_HAPPY) {
                enterState(ST_PLAIN);
            }
            break;

        case ST_DIZZY:
            if (stateElapsed >= DUR_DIZZY) {
                enterState(ST_PLAIN);
            }
            break;

        case ST_HOT:
            if (stateElapsed >= DUR_HOT) {
                enterState(ST_TEMP_COOLDOWN);
            }
            break;

        case ST_FREEZE:
            if (stateElapsed >= DUR_FREEZE) {
                enterState(ST_TEMP_COOLDOWN);
            }
            break;

        case ST_WAKE_RUB:
            if (stateElapsed >= DUR_WAKE_RUB_TOTAL) {
                stateAudioTrack = TRACK_HAPPY_SLEEP;
                enterState(ST_HAPPY);
            }
            break;

        case ST_TEMP_COOLDOWN:
            if (stateElapsed >= DUR_TEMP_COOLDOWN) {
                float avgTemp = currentTemp;
                if (tempCooldownCount > 0) {
                    avgTemp = tempCooldownSum / tempCooldownCount;
                }
                tempCooldownSum   = 0.0f;
                tempCooldownCount = 0;

                if (avgTemp > TEMP_HOT_THRESHOLD) {
                    enterState(ST_HOT);
                } else if (avgTemp < TEMP_COLD_THRESHOLD) {
                    enterState(ST_FREEZE);
                } else {
                    enterState(ST_PLAIN);
                }
            }
            break;

        default:
            break;
    }

    updateAnimation(millis());
}